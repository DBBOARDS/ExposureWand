/*-----------------------------------------------------------------------------------------------------------
  dbBoardsExposureWandA.ino
    Use with dbBoardsExposureWand.pde

  Summary:
    This program uses the image data from dbBoardsExposureWandP.pde to recreate the image using an attached 
    LED strip over a long exposure photograph or other long exposure recording.
  
  Utilizing:
    Adafruit NeoPixel Library: https://github.com/adafruit/Adafruit_NeoPixel
    
  Programmer:
    Duncan Brandt @ DB Boards, LLC
    Created: Jan 19, 2018
  
  Development Environment Specifics:
    Arduino 1.6.11
  
  Hardware Specifications:
    DB Boards 50 pixel LED Strip, DB7003
    Arduino Drawing Board (UNO) DB1000
    Soft Push Button DB7004

  Beerware License:
    This program is free, open source, and public domain. The program is distributed as is and is not
    guaranteed. However, if you like the code and find it useful I would happily take a beer should you 
    ever catch me at the local.
*///---------------------------------------------------------------------------------------------------------
// DB Boards Logo. Replace these three lines with text from exposureWand.txt
const PROGMEM  uint16_t r[]  = {0, 0, 0, 0, 0, 0, 0, 0, 0, 0, 0, 0, 0,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 0, 0};
const PROGMEM  uint16_t g[]  = {0, 0, 0, 0, 0, 0, 0, 0, 0, 0, 0, 0, 0,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 0, 0};
const PROGMEM  uint16_t b[]  = {0, 0, 0, 0, 0, 0, 0, 0, 0, 0, 0, 0, 0,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 0, 0};

#include <Adafruit_NeoPixel.h>                      // https://github.com/adafruit/Adafruit_NeoPixel
#define PIN 1                                       // Pin 1 (tx) for serial communication with LED strip
// 50  Number of pixels in strip, NEO_GRB  Pixels are wired for GRB bitstream, NEO_KHZ800  800 KHz bitstream
Adafruit_NeoPixel strip = Adafruit_NeoPixel(50, PIN, NEO_GRB + NEO_KHZ800);
int w = 75, h = 50;                                 // The image data from exposureWand.pde is 75 x 50 pixels
int wait = 20;                                      // This delay will affect the speed of the exposure
int btn = 6;                                        // Button pin is D6
//-----------------------------------------------------------------------------------------------------------
void setup() {                                      // The setup program ones only once after power-up or reset
  strip.begin();                                    // Activate the LED strand
  strip.show();                                     // Initialize all pixels to 'off'
  strip.setBrightness(30);                          // Affects the brightness of the entire program (0-255)
  pinMode(btn, INPUT_PULLUP);                       // Setup pin for raw button
}
//-----------------------------------------------------------------------------------------------------------
void loop() {                                       // The loop function runs repeatedly after setup completes
  while(digitalRead(btn)) delay(100);               // Wait while the button is inactive
  while(!digitalRead(btn)) delay(20);               // Don't start program until button is released
  for(int x = 0; x < w; x++){                       // Step through the width of the image, one col at a time
    for(int y = 0; y < h; y++){                     // Step through each pixel in the col
      int r = int(pgm_read_word_near(r + (y*w+x))); // Recall the current pixel's red value from memory
      int g = int(pgm_read_word_near(g + (y*w+x))); // Recall the current pixel's green value from memory
      int b = int(pgm_read_word_near(b + (y*w+x))); // Recall the current pixel's blue value from memory
      strip.setPixelColor(50-y, strip.Color(r,g,b));// Set the current pixel on the wand, starting from the bottom
    }
    strip.show();                                   // Expose the current col
    delay(wait);                                    // Delay pixel length
  }
  for(int a = 0; a < 50; a++){                      // Step through all the LEDs
    strip.setPixelColor(a, strip.Color(0,0,0));     // Turn them all off to end the image
  }
  strip.show();                                     // Update strip
}
//-----------------------------------------------------------------------------------------------------------
